## drivers/input_analog_joystick/Kconfig
```kconfig
menuconfig INPUT_ANALOG_JOYSTICK
    bool "Joystick Sensor"
    select ADC
    help
      Enable driver for Joystick sensor

if INPUT_ANALOG_JOYSTICK

config INPUT_ANALOG_JOYSTICK_WORKQUEUE_PRIORITY
    int "Workqueue priority"
    default 10
    help
      Priority of thread used by the workqueue

config INPUT_ANALOG_JOYSTICK_WORKQUEUE_STACK_SIZE
    int "Workqueue stack size"
    default 1024
    help
      Stack size of thread used by the workqueue

endif # INPUT_ANALOG_JOYSTICK
```

## dts/bindings/joystick/zmk,joystick.yaml
```yaml
description: |
  Sensor driver analog joystick

compatible: "zmk,input-analog-joystick"

include: base.yaml

properties:
  io-channels:
    type: phandle-array
    required: true
    description: |
      Channels available with this divider configuration.

  io-channel-names:
    type: string-array
    required: true
    description: |
      Channels names, use "X-AXIS" and "Y-AXIS" accordingly

  min-mv:
    type: int
    required: false
    description: |
      Minimum voltage output on the potentiometer

      If absent, a default 0 value will be used

  max-mv:
    type: int
    required: true
    description: |
      Maximum voltage output on the potentiometer

      max-mv - min-mv will be the full range of potentiometer output

  dead-zone:
    type: int
    required: false
    description: |
      Dead zone around the center wher the reading will snap to 0
```
